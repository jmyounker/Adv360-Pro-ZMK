#define VERSION_MACRO
macro_ver: macro_ver {
compatible = "zmk,behavior-macro";
label = "macro_ver";
#binding-cells = <0>;
bindings = <&kp N2>, <&kp N0>, <&kp N2>, <&kp N4>, <&kp N1>, <&kp N1>, <&kp N2>, <&kp N5>, <&kp MINUS>, <&kp J>, <&kp Y>, <&kp O>, <&kp U>, <&kp MINUS>, <&kp A>, <&kp N6>, <&kp A>, <&kp N0>, <&kp N8>, <&kp N7>, <&kp B>, <&kp RET>;
};
